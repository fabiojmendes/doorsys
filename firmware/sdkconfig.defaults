## firmware/sdkconfig.defaults
```kconfig
# Rust often needs a bit of an extra main task stack size compared to C (the default is 3K)
CONFIG_ESP_MAIN_TASK_STACK_SIZE=8000

# Use this to set FreeRTOS kernel tick frequency to 1000 Hz (100 Hz by default).
# This allows to use 1 ms granuality for thread sleeps (10 ms by default).
#CONFIG_FREERTOS_HZ=1000

# Workaround for https://github.com/espressif/esp-idf/issues/7631
#CONFIG_MBEDTLS_CERTIFICATE_BUNDLE=n
#CONFIG_MBEDTLS_CERTIFICATE_BUNDLE_DEFAULT_FULL=n

CONFIG_LWIP_LOCAL_HOSTNAME="doorsys"

CONFIG_MQTT_USE_CUSTOM_CONFIG=y
# CONFIG_MQTT_REPORT_DELETED_MESSAGES=y
# Retain messages for 24hrs
CONFIG_MQTT_OUTBOX_EXPIRED_TIMEOUT_MS=86400000
# Retain messages for 10min
# CONFIG_MQTT_OUTBOX_EXPIRED_TIMEOUT_MS=600000
```
